## config/boards/shields/keyb/Kconfig.shield
```kconfig
config SHIELD_KEYB_LEFT
    def_bool $(shields_list_contains,keyb_left)

config SHIELD_KEYB_RIGHT
    def_bool $(shields_list_contains,keyb_right)
```
